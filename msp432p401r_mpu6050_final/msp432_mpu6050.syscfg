// These arguments were used when this file was generated. They will be automatically applied on subsequent loads 
// via the GUI or CLI invocations. Run CLI with '--help' for additional information on how to override these arguments.
// @cliArgs --board "/ti/boards/MSP_EXP432P401R" --product "simplelink_msp432p4_sdk@3.30.00.13"
// @versions {"data":"2019083011","timestamp":"2019083011","tool":"1.2.952","templates":"2019083011"}

var RTOS = scripting.addModule("/ti/drivers/RTOS");
var I2C = scripting.addModule("/ti/drivers/I2C");
var I2C1 = I2C.addInstance();
// Name
RTOS.timer0.resource.$name = "MyTIMER_A1";
// Name - The C/C++ identifier used in applications as the index parameter passed to I2C runtime APIs
I2C1.$name = "CONFIG_I2C_0";
// Name
I2C1.i2c.$name = "MyI2C1";
// Assign pin
I2C1.i2c.sdaPin.$assign = "boosterpack.10"; // P6.4
// Assign pin
I2C1.i2c.sclPin.$assign = "boosterpack.9"; // P6.5
var Power = scripting.addModule("/ti/drivers/Power");
// Name
Power.performanceLevel3.$name = "ti_drivers_power_PowerMSP432PerfLevels0";
// Name
Power.performanceLevel2.$name = "ti_drivers_power_PowerMSP432PerfLevels1";
// Name
Power.performanceLevel1.$name = "ti_drivers_power_PowerMSP432PerfLevels2";
// Name
Power.performanceLevel0.$name = "ti_drivers_power_PowerMSP432PerfLevels3";
var Board = scripting.addModule("/ti/drivers/Board");
var DriverLib = scripting.addModule("/ti/devices/DriverLib");
// Suggest solution
RTOS.timer0.resource.$suggestSolution = "Timer_A0";
// Suggest solution
I2C1.i2c.$suggestSolution = "EUSCI_B1";
